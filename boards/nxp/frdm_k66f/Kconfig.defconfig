## boards/nxp/frdm_k66f/Kconfig.defconfig
```kconfig
# FRDM-K66F board

# Copyright (c) 2016, Freescale Semiconductor, Inc.
# SPDX-License-Identifier: Apache-2.0

if BOARD_FRDM_K66F

config OSC_XTAL0_FREQ
	default 12000000

config TEST_EXTRA_STACK_SIZE
	default 128

if NETWORKING

config NET_L2_ETHERNET
	default y if !MODEM

endif # NETWORKING

endif # BOARD_FRDM_K66F
```

## boards/nxp/frdm_k66f/board.yml
```yaml
board:
  name: frdm_k66f
  full_name: FRDM-K66F
  vendor: nxp
  socs:
    - name: mk66f18
```

## drivers/clock_control/Kconfig.gd32
```kconfig
# Copyright (c) 2022 Teslabs Engineering S.L.
# SPDX-License-Identifier: Apache-2.0

config CLOCK_CONTROL_GD32
    bool "GD32 clock control"
    default y
    depends on DT_HAS_GD_GD32_CCTL_ENABLED
    help
      Enable driver for Gigadevice Reset Clock Unit (RCU).

config CLOCK_GD32_CKOUT
    bool "GD32 CKOUT (microcontroller clock output)"
    default y
    depends on DT_HAS_GD_GD32_CKOUT_ENABLED
    help
      Enable configuration of CKOUT0 via devicetree. Useful to feed
      external peripherals (e.g. RMII PHY 50 MHz) directly from the MCU.
```

## drivers/counter/Kconfig.mcux_rtc
```kconfig
# MCUXpresso SDK RTC

# Copyright (c) 2018, NXP
# SPDX-License-Identifier: Apache-2.0

config COUNTER_MCUX_RTC
	bool "MCUX RTC driver"
	default y if !RTC
	depends on DT_HAS_NXP_RTC_ENABLED && !RTC
	help
	  Enable support for MCU RTC driver.
```

## drivers/entropy/Kconfig.gd32
```kconfig
# Copyright The Zephyr Project Contributors
# SPDX-License-Identifier: Apache-2.0

config ENTROPY_GD32_TRNG
    bool "GD32 TRNG entropy driver"
    depends on DT_HAS_GD_GD32_TRNG_ENABLED
    default y
    select ENTROPY_HAS_DRIVER
    select USE_GD32_TRNG
    help
      Enable the GD32 true random number generator (TRNG) entropy driver.

if ENTROPY_GD32_TRNG

config ENTROPY_GD32_POOL_SIZE
    int "Entropy pool size"
    range 8 512
    default 32
    help
      Size in bytes of the single entropy pool filled by the TRNG ISR.
      Must be a power of two.

endif # ENTROPY_GD32_TRNG
```

## drivers/ethernet/Kconfig.gd32
```kconfig
# Copyright (c) 2026 Ylhyra ehf.
# SPDX-License-Identifier: Apache-2.0

config ETH_GD32_DWC_ETHER_1000
	bool "GD32 Ethernet MAC driver"
	depends on DT_HAS_GD_GD32_ETHERNET_ENABLED
	depends on SOC_SERIES_GD32F4XX
	select ETH_DWC_ETHER_1000_CORE
	select PINCTRL
	select HWINFO
	select CRC
	select RESET
	imply NVMEM if $(dt_compat_any_has_prop,$(DT_COMPAT_GD_GD32_ETHERNET),nvmem-cells)
	default y
	help
	  Use Zephyr's native Synopsys DesignWare Ethernet MAC 10/100/1G
	  Universal v3.x core with GD32-specific clock, reset, pinctrl and
	  RMII/MII platform integration.
```

## drivers/ethernet/mdio/Kconfig.gd32
```kconfig
# Copyright (c) 2026 Ylhyra ehf.
# SPDX-License-Identifier: Apache-2.0

config MDIO_GD_GD32
	bool "GD32 MDIO controller"
	depends on DT_HAS_GD_GD32_MDIO_ENABLED
	default y
	select USE_GD32_ENET
	select USE_GD32_RCU
	select USE_GD32_SYSCFG
	help
	  Enable MDIO controller support for GD32 ENET. Provides a Clause 22
	  MDIO bus backed by the on-chip ENET MAC MII management interface.
```

## drivers/hwinfo/Kconfig.gd32
```kconfig
# Copyright The Zephyr Project Contributors
# SPDX-License-Identifier: Apache-2.0

config HWINFO_GD32
	bool "GD32 HWINFO"
	default y
	depends on SOC_SERIES_GD32F4XX
	select HWINFO_HAS_DRIVER
	help
	  Enable HWINFO support for GD32F4xx.

	  This driver provides:
	  - Device unique ID (96-bit UID) readout via the GD32 UID registers.
	  - Reset cause reporting via the RCU reset status register (RCU_RSTSCK).

	  Supported reset causes are reported based on the reset flag macros
	  available in the GigaDevice HAL headers (for example external pin reset,
	  watchdog reset, software reset, brownout reset, power-on reset).
```

## drivers/i2c/Kconfig.gd32
```kconfig
# Copyright (c) 2021 BrainCo Inc.
# SPDX-License-Identifier: Apache-2.0

config I2C_GD32
	bool "GigaDevice GD32 I2C driver"
	default y
	depends on DT_HAS_GD_GD32_I2C_ENABLED
	select PINCTRL
	help
	  Enables GigaDevice GD32 I2C driver

if I2C_GD32

config I2C_GD32_DMA
	bool "DMA support for GD32 I2C driver"
	default y
	depends on $(dt_compat_any_has_prop,$(DT_COMPAT_GD_GD32_I2C),dmas)
	depends on I2C_GD32
	select DMA
	help
	  Use DMA for GD32 I2C controller mode transfers when DMA channels are
	  described in devicetree.

endif # I2C_GD32
```

## drivers/i2s/Kconfig.gd32
```kconfig
# Copyright (c) 2026 Ylhyra ehf.
# SPDX-License-Identifier: Apache-2.0

menuconfig I2S_GD32
	bool "GigaDevice GD32 I2S driver"
	default y
	depends on DT_HAS_GD_GD32_I2S_ENABLED
	depends on SOC_SERIES_GD32F4XX
	select PINCTRL
	select DMA
	select CACHE_MANAGEMENT if CPU_HAS_DCACHE
	select USE_GD32_SPI
	help
	  Enable the GD32 I2S driver. Only DMA transfers are supported.

if I2S_GD32

config I2S_GD32_RX_BLOCK_COUNT
	int "RX queue block count"
	default 4
	help
	  Number of RX blocks that can be queued internally.

config I2S_GD32_TX_BLOCK_COUNT
	int "TX queue block count"
	default 8
	help
	  Number of TX blocks that can be queued internally.

config I2S_GD32_MAX_CLOCK_ERROR_PPM
	int "Maximum controller-mode frame clock error in ppm"
	default 1000
	range 0 1000000
	help
	  Maximum difference between the requested and generated frame clock.
	  Set to 0 to accept the closest rate supported by the clock tree.

endif # I2S_GD32
```

## drivers/rtc/Kconfig.gd32
```kconfig
# Copyright (c) 2026 Ylhyra ehf.
# SPDX-License-Identifier: Apache-2.0

config RTC_GD32
	bool "GD32 RTC driver"
	depends on DT_HAS_GD_GD32_RTC_ENABLED
	default y
	select USE_GD32_RTC
	select USE_GD32_PMU
	select USE_GD32_RCU
	select USE_GD32_EXTI if RTC_ALARM || RTC_UPDATE
	help
	  Enable the RTC driver for GD32 SoCs. The driver provides timekeeping
	  and optional alarm support using the on-chip backup domain.
```

## drivers/rtc/Kconfig.mcux_rtc
```kconfig
# Copyright (c) 2026, Ylhyra ehf.
# SPDX-License-Identifier: Apache-2.0

config RTC_MCUX_RTC
	bool "MCUX RTC driver"
	default y
	depends on DT_HAS_NXP_RTC_ENABLED
	help
	  Enable the RTC driver for NXP MCUX RTC peripherals.
```

## drivers/sdhc/Kconfig.gd32
```kconfig
# Copyright (c) 2026 Ylhyra ehf.
# SPDX-License-Identifier: Apache-2.0

config SDHC_GD32
	bool "GD32 SDIO SDHC driver"
	default y
	depends on DT_HAS_GD_GD32_SDHC_ENABLED
	select SDHC_SUPPORTS_NATIVE_MODE
	select USE_GD32_SDIO
	select USE_GD32_DMA
	select DMA
	select MEM_ATTR
	select PINCTRL
	help
	  Enables the GD32 SDIO-based SDHC driver (DMA-only data transfers).

if SDHC_GD32

config SDHC_BUFFER_ALIGNMENT
	default 4

config SD_BUFFER_SIZE
	int
	default 512

config SDHC_GD32_VERBOSE_DATA_ERRORS
	bool "Verbose LOG_ERR + hw-state dump on data-path failures"
	default n
	help
	  Enable rich LOG_ERR + dump_hw_state diagnostics in
	  gd32_sdhc_wait_data_done when an SDIO/DMA transfer fails.
	  The function still returns -ETIMEDOUT / -EIO / -ENODEV to the
	  caller in either case; this only controls in-driver logging.

	  Off by default because each LOG_ERR site (7-8 args) inflates
	  cbprintf scratch into the inlined gd32_sdhc_request frame and
	  pushes the SDHC tail above 700 B on the caller's stack. Turn
	  on only when diagnosing data-path failures.

endif # SDHC_GD32
```

## drivers/sdhc/Kconfig.kinetis
```kconfig
# Copyright (c) 2026 Ylhyra ehf.
# SPDX-License-Identifier: Apache-2.0

config SDHC_KINETIS
	bool "NXP Kinetis SDHC driver"
	default y
	depends on DT_HAS_NXP_KINETIS_SDHC_ENABLED
	select SDHC_SUPPORTS_NATIVE_MODE
	select PINCTRL
	help
	  Enable the NXP Kinetis SDHC host controller driver.

if SDHC_KINETIS

config SDHC_BUFFER_ALIGNMENT
	default DCACHE_LINE_SIZE if DCACHE
	default 4
	help
	  SDHC buffers should be cache-line aligned when they are placed in a
	  cacheable region.

config SDHC_KINETIS_TEST
	bool "NXP Kinetis SDHC test fault injection"
	depends on ZTEST
	help
	  Enables test-only fault injection used by the Kinetis SDHC hardware
	  regression application. This option adds no production state or code.

config SDHC_KINETIS_ADMA_TABLE_WORDS
	int "Kinetis SDHC ADMA descriptor table size in words"
	default 8
	range 4 128
	help
	  Size of the per-controller ADMA2 descriptor table. Each descriptor uses
	  two words and describes up to 65535 bytes. The default supports transfers
	  up to 196605 bytes, including the terminating descriptor.

endif # SDHC_KINETIS
```

## drivers/serial/Kconfig.gd32
```kconfig
# Copyright (c) 2021 ATL Electronics
# SPDX-License-Identifier: Apache-2.0

config USART_GD32
	bool "GD32 serial driver"
	default y
	depends on DT_HAS_GD_GD32_USART_ENABLED
	select PINCTRL
	select SERIAL_HAS_DRIVER
	select SERIAL_SUPPORT_INTERRUPT
	select SERIAL_SUPPORT_ASYNC
	select USE_GD32_USART
	select DMA if UART_ASYNC_API && $(dt_compat_any_has_prop,$(DT_COMPAT_GD_GD32_USART),dmas)
	help
	  This option enables the USART driver for GD32 SoC family.
```

## drivers/spi/Kconfig.gd32
```kconfig
# Copyright (c) 2021 BrainCo Inc.
# SPDX-License-Identifier: Apache-2.0

config SPI_GD32
	bool "Gigadevice GD32 SPI driver"
	default y
	depends on DT_HAS_GD_GD32_SPI_ENABLED
	select PINCTRL
	select GPIO if $(dt_compat_any_has_prop,$(DT_COMPAT_GD_GD32_SPI),cs-gpios)
	select SPI_GD32_INTERRUPT if SPI_ASYNC
	help
	  Enables Gigadevice GD32 SPI driver.

if SPI_GD32

config SPI_GD32_INTERRUPT
	bool "GD32 MCU SPI Interrupt Support"
	default y if SPI_ASYNC || SPI_RTIO
	help
	  Enable the interrupt driven mode for SPI instances

config SPI_GD32_DMA
	bool "GD32 MCU SPI DMA Support"
	select SPI_GD32_INTERRUPT
	select DMA
	select CACHE_MANAGEMENT if CPU_HAS_DCACHE
	help
	  Use the DMA for SPI transfer
	  that enable dma channels in their device tree node.

if SPI_RTIO

config SPI_GD32_RTIO_SQ_SIZE
	int "Number of available submission queue entries"
	default 8
	help
	  Number of RTIO submission queue entries reserved by each GD32 SPI
	  controller instance when native RTIO support is enabled.

config SPI_GD32_RTIO_CQ_SIZE
	int "Number of available completion queue entries"
	default 8
	help
	  Number of RTIO completion queue entries reserved by each GD32 SPI
	  controller instance when native RTIO support is enabled.

endif # SPI_RTIO

endif # SPI_GD32
```

## dts/bindings/clock/gd,gd32-ckout.yaml
```yaml
# SPDX-License-Identifier: Apache-2.0
# Copyright (c) 2026 Ylhyra ehf.

description: GigaDevice GD32F4xx microcontroller clock output

compatible: "gd,gd32-ckout"

include:
  - name: base.yaml
  - name: pinctrl-device.yaml

properties:
  output:
    type: int
    required: true
    enum: [0, 1]
    description: CKOUT output index.

  clock-frequency:
    type: int
    required: true
    description: Required output frequency in hertz.

  gd,clock-source:
    type: string
    required: true
    enum: ["pllp"]
    description: Clock source routed to the CKOUT divider.

  pinctrl-0:
    required: true

  pinctrl-names:
    required: true
```

## dts/bindings/ethernet/gd,gd32-ethernet.yaml
```yaml
# Copyright (c) 2026, Ylhyra ehf.
# SPDX-License-Identifier: Apache-2.0

title: GigaDevice GD32 Ethernet MAC

description: |
  Synopsys DesignWare Ethernet MAC 10/100/1G Universal integrated in
  GigaDevice GD32 SoCs. GD32 integrations support 10 and 100 Mbit/s MII
  and RMII interfaces.

compatible: "gd,gd32-ethernet"

include:
  - name: snps,dwmac.yaml
  - name: pinctrl-device.yaml
  - name: reset-device.yaml

properties:
  reg:
    required: true

  clocks:
    required: true

  clock-names:
    required: true

  interrupts:
    required: true

  resets:
    required: true

  pinctrl-0:
    required: true

  pinctrl-names:
    required: true

  phy-connection-type:
    required: true

  phy-handle:
    required: true

  gd,phy-mode-selector:
    type: phandle
    required: true
    description: |
      Syscon holding the MII/RMII selection register. Its clocks property
      supplies the clock that must run before the register is written.

  gd,phy-mode-offset:
    type: int
    required: true
    description: |
      Offset of the MII/RMII selection register within the selector
      peripheral.

  gd,phy-mode-mask:
    type: int
    required: true
    description: |
      Mask of the MII/RMII selection bit. A set bit selects RMII and a
      cleared bit selects MII.

  snps,clk-csr:
    description: |
      Use this property on integrations whose MDC divider table differs from
      the standard DWMAC v3 table. In particular, GD32H7 CSR index 6 divides
      the clock by 142 rather than 204.
```

## dts/bindings/ethernet/mdio/gd,gd32-mdio.yaml
```yaml
# Copyright (c) 2026 Ylhyra ehf.
# SPDX-License-Identifier: Apache-2.0

description: GigaDevice GD32 MDIO Controller

compatible: "gd,gd32-mdio"

include: [mdio-controller.yaml, pinctrl-device.yaml]

properties:
  clocks:
    required: true

  pinctrl-0:
    required: true

  pinctrl-names:
    required: true
```

## dts/bindings/i2c/gd,gd32-i2c.yaml
```yaml
# Copyright (c) 2021 BrainCo Inc.
# SPDX-License-Identifier: Apache-2.0

description: GigaDevice GD32 I2C

compatible: "gd,gd32-i2c"

include: [i2c-controller.yaml, reset-device.yaml, pinctrl-device.yaml]

properties:
  reg:
    required: true

  interrupts:
    required: true

  resets:
    required: true

  clocks:
    required: true

  scl-gpios:
    type: phandle-array
    required: false
    description: |
      Optional GPIO used for I2C bus recovery. When provided together with
      sda-gpios, the driver can toggle SCL to recover a wedged bus.

  sda-gpios:
    type: phandle-array
    required: false
    description: |
      Optional GPIO used for I2C bus recovery. When provided together with
      scl-gpios, the driver can monitor SDA while toggling SCL.

  pinctrl-0:
    required: true

  pinctrl-names:
    required: true

  dmas:
    type: phandle-array
    required: false
    description: |
      Optional RX and TX DMA specifiers used for controller mode transfers.

      Entries must be ordered as "rx", "tx" and match the gd32 DMA binding.

  dma-names:
    required: false
    description: |
      Required when dmas is present. Use "rx", "tx" to match the DMA entries.
```

## dts/bindings/i2s/gd,gd32-i2s.yaml
```yaml
# Copyright (c) 2026 Ylhyra ehf.
# SPDX-License-Identifier: Apache-2.0

include: [i2s-controller.yaml, pinctrl-device.yaml]

compatible: "gd,gd32-i2s"

properties:
  reg:
    required: true

  interrupts:
    required: true

  clocks:
    required: true

  resets:
    type: phandle-array
    required: true

  dmas:
    required: true
    description: DMA channels used for reception and transmission.

  dma-names:
    required: true
    description: Must contain "rx" and "tx".

  pinctrl-0:
    required: true

  pinctrl-names:
    required: true

  mck-enabled:
    type: boolean
    description: Enable master clock (MCK) output when in master mode.

  ws-gpios:
    type: phandle-array
    description: |
      The WS (frame clock) pin, read as a GPIO while the I2S is a target. A
      target must be enabled before its master starts a frame; with this
      property it arms in the half frame before the next frame starts, so it
      can start while the master is already clocking. The pin stays muxed to
      the I2S.
```
