## dts/bindings/mfd/gd,gd32-rcu.yaml
```yaml
# Copyright (c) 2022, Teslabs Engineering S.L.
# Copyright (c) 2025 Meshium
#               Aleksandr Senin <al@meshium.net>
#
# SPDX-License-Identifier: Apache-2.0

title: Gigadevice RCU (Reset and Clock Unit)

description: |
  Gigadevice Reset and Clock Unit (RCU) if a multi-function peripheral in
  charge of reset control (RCTL) and clock control (CCTL) for all SoC
  peripherals. Child nodes are used to represent each functional block.

compatible: "gd,gd32-rcu"

include: base.yaml

properties:
  reg:
    required: true

  gd,ck48m-source:
    type: string
    enum:
      - "irc48m"
      - "pll48m"
    description: |
      Select the CK48M clock source. CK48M is used by TRNG/SDIO/USBFS/USBHS.
      When set to "irc48m", the SoC initialization code enables the IRC48M
      oscillator and selects it as CK48M source.
      When set to "pll48m", the SoC initialization code selects PLL48M as CK48M
      source (see gd,pll48m-source).

  gd,pll48m-source:
    type: string
    enum:
      - "pllq"
      - "pllsaip"
    default: "pllq"
    description: |
      Select the PLL48M source (CK_PLLQ or CK_PLLSAIP) when gd,ck48m-source is
      set to "pll48m". This does not configure PLL/PLLSAI parameters; board
      clock configuration must ensure the selected source provides a valid
      48MHz clock domain.

  gd,ckout0-source:
    type: string
    enum:
      - "pllp"
      - "pll2"
    description: |
      Select the CK_OUT0 clock source. "pllp" is available on GD32F4xx and
      "pll2" is available on GD32E50x. The CK_OUT0 pin must also be present in
      the board pin control state.

  gd,ckout0-divider:
    type: int
    enum: [1, 2, 3, 4, 5]
    default: 1
    description: |
      Divide the selected CK_OUT0 source. This property is used by GD32F4xx;
      GD32E50x does not provide a CK_OUT0 divider.

  gd,ckout0-pll2-multiplier:
    type: int
    enum: [10]
    description: |
      Configure and enable the GD32E50x PLL2 source before routing it to
      CK_OUT0. The supported value produces the 50 MHz reference clock used
      by GD32E507 evaluation-board Ethernet PHYs.
```

## dts/bindings/rng/gd,gd32-trng.yaml
```yaml
# Copyright (c) 2026, The Zephyr Project Contributors
# SPDX-License-Identifier: Apache-2.0

description: GD32 TRNG

compatible: "gd,gd32-trng"

include: ["base.yaml", "reset-device.yaml"]

properties:
  reg:
    required: true

  clocks:
    required: true

  resets:
    required: false

  interrupts:
    required: true
```

## dts/bindings/rtc/gd,gd32-rtc.yaml
```yaml
# Copyright (c) 2026, The Zephyr Project Contributors
# SPDX-License-Identifier: Apache-2.0

description: GD32 RTC

compatible: "gd,gd32-rtc"

include:
  - rtc.yaml
  - rtc-device.yaml

properties:
  reg:
    required: true

  clock-source:
    type: string
    enum:
      - lxtal
      - irc40k
      - irc32k
      - hxtal-div32
      - hxtal-div-rtcdiv
    required: true
    description: RTC clock source selection for the active GD32 RTC family.

  hxtal-div:
    type: int
    default: 2
    description: HXTAL division factor when the selected family uses an RTCDIV clock source.

  lxtal-drive-high:
    type: boolean
    description: Enable higher drive strength for the LXTAL oscillator.

  alarms-count:
    required: true

  interrupts:
    required: true
    description: |
      Interrupts must include the RTC alarm interrupt and may include the RTC wakeup interrupt
      when the hardware supports wakeup events.

  interrupt-names:
    required: true
    description: |
      Interrupt names must include "alarm" and may also include "wakeup" for families with a
      wakeup timer.
```
