/*
 * Copyright (c) 2026, Ylhyra ehf.
 * SPDX-License-Identifier: Apache-2.0
 */

&spi5 {
	status = "disabled";
};

&rcu {
	gd,ckout0-source = "pllp";
	gd,ckout0-divider = <4>;
};

&enet {
	status = "okay";
};

&mdio {
	status = "okay";
};
