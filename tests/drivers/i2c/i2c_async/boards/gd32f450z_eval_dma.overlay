/*
 * Copyright (c) 2026 Ylhyra ehf.
 * SPDX-License-Identifier: Apache-2.0
 */

#include <zephyr/dt-bindings/dma/gd32_dma.h>

&dma0 {
	status = "okay";
};

&i2s1 {
	status = "disabled";
};

&i2c0 {
	dmas = <&dma0 0 1 0 0>, <&dma0 6 1 GD32_DMA_PRIORITY_HIGH 0>;
	dma-names = "rx", "tx";
};

&i2c1 {
	dmas = <&dma0 2 7 0 0>, <&dma0 7 7 GD32_DMA_PRIORITY_HIGH 0>;
	dma-names = "rx", "tx";
};
