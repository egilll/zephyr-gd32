## CMakeLists.txt
```
# SPDX-License-Identifier: Apache-2.0

cmake_minimum_required(VERSION 3.28.0)
find_package(Zephyr REQUIRED HINTS $ENV{ZEPHYR_BASE})
project(hostname_disabled)

target_sources(app PRIVATE src/main.c)
```

## prj.conf
```kconfig
CONFIG_NETWORKING=y
CONFIG_NET_IPV4=y
CONFIG_NET_IPV6=n
CONFIG_NET_HOSTNAME_ENABLE=n
```

## prj_no_networking.conf
```kconfig
CONFIG_NETWORKING=n
```

## src/main.c
```c
/*
 * Copyright (c) 2026, Ylhyra ehf.
 *
 * SPDX-License-Identifier: Apache-2.0
 */

#include <zephyr/net/dns_resolve.h>
#include <zephyr/net/hostname.h>

BUILD_ASSERT(NET_HOSTNAME_MAX_LEN == sizeof("zephyr") - 1);
BUILD_ASSERT(NET_HOSTNAME_SIZE == 1);

int main(void)
{
	return 0;
}
```
