/*
 * Copyright (c) 2026
 *
 * SPDX-License-Identifier: Apache-2.0
 */

/ {
	aliases {
		i2s-tx = &i2s1;
	};
};

&i2s1 {
	status = "okay";
	pinctrl-0 = <&i2s1_default>;
	pinctrl-names = "default";
	mck-enabled;
};
