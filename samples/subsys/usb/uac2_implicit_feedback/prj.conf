## CMakeLists.txt
```
# SPDX-License-Identifier: Apache-2.0

cmake_minimum_required(VERSION 3.20.0)
find_package(Zephyr REQUIRED HINTS $ENV{ZEPHYR_BASE})
project(usb_audio_async_i2s)

include(${ZEPHYR_BASE}/samples/subsys/usb/common/common.cmake)
target_sources(app PRIVATE src/main.c)

if(CONFIG_SOC_COMPATIBLE_NRF5340_CPUAPP OR CONFIG_SOC_SERIES_NRF54H)
  target_sources(app PRIVATE src/feedback_nrf.c)
elseif(CONFIG_SOC_FAMILY_GD_GD32)
  target_sources(app PRIVATE src/feedback_gd32.c)
else()
  target_sources(app PRIVATE src/feedback_dummy.c)
endif()
```

## prj.conf
```kconfig
CONFIG_I2S=y

#USB related configs
CONFIG_USB_DEVICE_STACK_NEXT=y
CONFIG_CDC_ACM_SERIAL_INITIALIZE_AT_BOOT=n
CONFIG_USBD_AUDIO2_CLASS=y
CONFIG_SAMPLE_USBD_PID=0x000F
CONFIG_SAMPLE_USBD_PRODUCT="UAC2 implicit feedback sample"

#LOG subsystem related configs
CONFIG_LOG=y
#CONFIG_USBD_LOG_LEVEL_WRN=y
#CONFIG_UDC_DRIVER_LOG_LEVEL_WRN=y

CONFIG_USBD_LOG_LEVEL_INF=y
CONFIG_UDC_DRIVER_LOG_LEVEL_INF=y
#CONFIG_UDC_DRIVER_LOG_LEVEL_DBG=y
CONFIG_LOG_MODE_IMMEDIATE=y
```

## boards/gd32f450z_eval_gd32f450.overlay
```dts
/*
 * Copyright (c) 2026 Ylhyra ehf.
 * SPDX-License-Identifier: Apache-2.0
 */

/* Pull in the common UAC2 devicetree description for this sample. */
#include "../app.overlay"

/* Provide a stable node label for samples that expect a single full-duplex I2S
 * device for both RX and TX.
 */
i2s_rxtx: &i2s1 {};
```

## src/feedback_gd32.c
```c
/*
 * Copyright (c) 2026 Ylhyra ehf.
 *
 * SPDX-License-Identifier: Apache-2.0
 */

#include <zephyr/device.h>
#include <zephyr/drivers/i2s/i2s_gd32.h>
#include <zephyr/drivers/usb/udc_dwc2.h>
#include <zephyr/kernel.h>
#include <zephyr/sys_clock.h>
#include <zephyr/sys/util.h>

#include "feedback.h"

/*
 * GD32 implementation notes
 * ------------------------
 *
 * The upstream sample's "ideal" requirement is a hardware timestamp of I2S
 * frame start relative to the USB SOF. Without changing the generic USB stack,
 * we approximate SOF time using the SOF callback execution time
 * (k_cycle_get_32()) and use a GD32 I2S driver-provided timestamp for the most
 * recent TX DMA block start.
 *
 * This is sufficient to make the sample functional on GD32F450, but the
 * achievable accuracy depends on interrupt latency and scheduling jitter.
 */

struct feedback_ctx {
	const struct device *i2s_dev;
	const struct device *udc_dev;

	/* Q16 fixed-point values (cycle_count << 16) */
	uint64_t cycles_per_sample_q16;
	uint64_t cycles_per_frame_q16;
	int64_t rel_sof_offset_q16;
	int64_t base_sof_offset_q16;

	unsigned int nominal;
};

static struct feedback_ctx fb_ctx;

static inline int64_t normalize_offset_q16(int64_t offset_q16, uint64_t period_q16)
{
	const int64_t half = (int64_t)(period_q16 / 2U);

	if (offset_q16 > half) {
		return offset_q16 - (int64_t)period_q16;
	}

	if (offset_q16 < -half) {
		return offset_q16 + (int64_t)period_q16;
	}

	return offset_q16;
}

struct feedback_ctx *feedback_init(void)
{
	fb_ctx.i2s_dev = DEVICE_DT_GET(DT_NODELABEL(i2s_rxtx));
	fb_ctx.udc_dev = DEVICE_DT_GET(DT_NODELABEL(zephyr_udc0));
	fb_ctx.cycles_per_sample_q16 = 0U;
	fb_ctx.cycles_per_frame_q16 = 0U;
	fb_ctx.rel_sof_offset_q16 = 0;
	fb_ctx.base_sof_offset_q16 = 0;
	fb_ctx.nominal = 0U;

	return &fb_ctx;
}

void feedback_process(struct feedback_ctx *ctx)
{
	uint32_t sof_cycle;
	uint32_t block_cycle;
	int32_t delta_cycles;
	int64_t delta_q16;

	if (ctx->cycles_per_frame_q16 == 0U || ctx->cycles_per_sample_q16 == 0U) {
		return;
	}

	sof_cycle = udc_dwc2_sof_cycle_get(ctx->udc_dev);
	block_cycle = i2s_gd32_tx_block_start_cycle_get(ctx->i2s_dev);

	delta_cycles = (int32_t)(block_cycle - sof_cycle);
	delta_q16 = ((int64_t)delta_cycles) << 16;

	ctx->rel_sof_offset_q16 = normalize_offset_q16(delta_q16, ctx->cycles_per_frame_q16);
}

void feedback_reset_ctx(struct feedback_ctx *ctx)
{
	ARG_UNUSED(ctx);
}

void feedback_start(struct feedback_ctx *ctx, int i2s_blocks_queued, bool microframes)
{
	uint64_t cycles_per_sec = sys_clock_hw_cycles_per_sec();

	ctx->nominal = microframes ? (SAMPLE_RATE / 8000U) : (SAMPLE_RATE / 1000U);

	ctx->cycles_per_sample_q16 = (cycles_per_sec << 16) / SAMPLE_RATE;
	ctx->cycles_per_frame_q16 = ctx->cycles_per_sample_q16 * ctx->nominal;

	/* Treat the initial state as "half-frame late" so the first normalized
	 * measurement won't accidentally wrap the wrong way.
	 */
	ctx->rel_sof_offset_q16 = (int64_t)(ctx->cycles_per_frame_q16 / 2U);

	/* If there are more than 2 I2S TX blocks queued, the I2S start is delayed.
	 * Convert the backlog (in frames) into a base offset estimate.
	 */
	ctx->base_sof_offset_q16 = (int64_t)MAX(i2s_blocks_queued - 2, 0) *
				   (int64_t)ctx->cycles_per_frame_q16;
}

int feedback_samples_offset(struct feedback_ctx *ctx)
{
	int64_t offset_q16;

	if (ctx->cycles_per_sample_q16 == 0U) {
		return 0;
	}

	offset_q16 = ctx->rel_sof_offset_q16 + ctx->base_sof_offset_q16;
	return (int)(offset_q16 / (int64_t)ctx->cycles_per_sample_q16);
}
```
