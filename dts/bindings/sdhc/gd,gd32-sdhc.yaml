## dts/bindings/sdhc/gd,gd32-sdhc.yaml
```yaml
# Copyright (c) 2026 Ylhyra ehf.
# SPDX-License-Identifier: Apache-2.0

description: GD32 SD host controller

compatible: "gd,gd32-sdhc"

include: [sdhc.yaml, pinctrl-device.yaml, reset-device.yaml]

properties:
  reg:
    required: true

  interrupts:
    required: true

  bus-width:
    type: int
    default: 1
    enum:
      - 1
      - 4
      - 8
    description: |
      Maximum bus width supported by the board wiring.

  dmas:
    description: DMA channel used for data transfers (reused for RX and TX)
    required: true
    type: phandle-array

  cd-gpios:
    type: phandle-array
    required: false
    description: Optional card-detect GPIO
```

## dts/bindings/sdhc/nxp,kinetis-sdhc.yaml
```yaml
# Copyright (c) 2026, The Zephyr Project Contributors
# SPDX-License-Identifier: Apache-2.0

description: NXP Kinetis SDHC controller

compatible: "nxp,kinetis-sdhc"

include: [sdhc.yaml, pinctrl-device.yaml]

properties:
  reg:
    required: true

  interrupts:
    required: true

  clocks:
    required: true

  bus-width:
    type: int
    default: 4
    enum:
      - 1
      - 4
      - 8
    description: |
      Maximum bus width supported by the board wiring.

  cd-gpios:
    type: phandle-array
    required: false
    description: Optional external card-detect GPIO

  pwr-gpios:
    type: phandle-array
    required: false
    description: |
      Optional GPIO controlling power to the external SD card slot. When
      present, the driver uses it to honor SDHC power mode transitions.

  pinctrl-0:
    required: true

  pinctrl-names:
    required: true
```

## dts/bindings/serial/gd,gd32-usart.yaml
```yaml
# Copyright (c) 2021, ATL Electronics
# SPDX-License-Identifier: Apache-2.0

description: GigaDevice USART

compatible: "gd,gd32-usart"

include: [uart-controller.yaml, reset-device.yaml, pinctrl-device.yaml]

properties:
  reg:
    required: true

  interrupts:
    required: true

  resets:
    required: true

  clocks:
    required: true

  dmas:
    type: phandle-array
    required: false
    description: |
      Optional RX and TX DMA specifiers used by the asynchronous UART API.

      Entries must be ordered as "rx", "tx" and match the gd32 DMA binding,
      for example: <&dma1 2 4 0 0>, <&dma1 7 4 0 0>.

  dma-names:
    required: false
    description: |
      Required when dmas is present. Use "rx", "tx" to match the DMA entries.

  gd,rx-dma-circular:
    type: boolean
    description: Enable circular DMA mode for RX. When set, the UART driver
      programs RX DMA in circular mode and reports UART_RX_RDY at half and full
      buffer boundaries.
```

## dts/bindings/serial/nxp,kinetis-uart.yaml
```yaml
description: Kinetis UART

compatible: "nxp,kinetis-uart"

include: [uart-controller.yaml, pinctrl-device.yaml]

properties:
  reg:
    required: true

  interrupts:
    required: true

  clocks:
    required: true

  pinctrl-0:
    required: true

  dmas:
    type: phandle-array
    required: false
    description: |
      Optional RX and TX DMA specifiers used by the asynchronous UART API.

  dma-names:
    required: false
    description: |
      Required when dmas is present. Use "rx", "tx" to match the DMA entries.
```

## dts/bindings/usb/gd,gd32-usbfs.yaml
```yaml
# Copyright (c) 2026 Ylhyra ehf.
# SPDX-License-Identifier: Apache-2.0

description: GD32 USBFS DWC2 compatible controller

compatible: "gd,gd32-usbfs"

include: ["snps,dwc2.yaml", "pinctrl-device.yaml"]

properties:
  clocks:
    required: true
    description: |
      USBFS peripheral clock and any additional clocks needed to provide the
      required 48 MHz USB clock for the embedded FS PHY (e.g. enabling IRC48M
      and selecting CK48M source).

  resets:
    type: phandle-array
    description: |
      Optional reset line for the USBFS peripheral. Recommended to ensure the
      controller starts from a clean state, matching vendor initialization.

  vbus-sensing:
    type: boolean
    description: |
      Enable VBUS sensing on the VBUS pin (do not set VBUSIG).

      Reference: GD32_28_USBFS.md describes that in device mode VBUS detection
      is controlled by the VBUSIG bit in USBFS_GCCFG. If this property is not
      present, the driver will set VBUSIG and treat VBUS as always valid.
```

## dts/bindings/usb/gd,gd32-usbhs.yaml
```yaml
# Copyright (c) 2026 Ylhyra ehf.
# SPDX-License-Identifier: Apache-2.0

description: GD32 USBHS DWC2 compatible controller

compatible: "gd,gd32-usbhs"

include: ["snps,dwc2.yaml", "pinctrl-device.yaml"]

properties:
  clocks:
    required: true
    description: |
      Core USBHS clock, followed by optional ULPI PHY clock for high-speed.
      If using the internal embedded FS PHY, the board may additionally provide
      clocks needed to provide the required 48 MHz USB clock (e.g. enabling
      IRC48M and selecting CK48M source).

  resets:
    type: phandle-array
    description: |
      Optional reset line for the USBHS peripheral. Recommended to ensure the
      controller starts from a clean state, matching vendor initialization.

  vbus-sensing:
    type: boolean
    description: |
      Enable VBUS sensing on the VBUS pin (do not set VBUSIG) when using the
      internal embedded FS PHY.

      Reference: GD32_29_USBHS.md describes that in device mode VBUS detection
      is controlled by the VBUSIG bit in USBHS_GCCFG. If this property is not
      present, the driver will set VBUSIG and treat VBUS as always valid.
```

## dts/bindings/usb/snps,dwc2.yaml
```yaml
# Copyright (c) 2023 Nordic Semiconductor ASA
# SPDX-License-Identifier: Apache-2.0

description: DesignWare OTG USB 2.0 controller

compatible: "snps,dwc2"

include: [base.yaml]

bus: usb

properties:
  reg:
    required: true

  interrupts:
    required: true

  phys:
    type: phandle

  num-in-eps:
    type: int
    required: true
    description: |
      Number of configured IN endpoints including control endpoint.

  num-out-eps:
    type: int
    required: true
    description: |
      Number of configured OUT endpoints including control endpoint.

  ghwcfg1:
    type: int
    required: true
    description: |
      Value of the GHWCFG1 register. It is used to determine available endpoint
      types during driver pre-initialization.

  ghwcfg2:
    type: int
    required: true
    description: |
      Value of the GHWCFG2 register. It is used to determine available endpoint
      types during driver pre-initialization.

  ghwcfg3:
    type: int
    description: |
      Value of the GHWCFG3 register.

      Only a subset of fields is used by the UDC driver (DFIFODEPTH, transfer
      size width, packet count width). Some integrations do not expose GHWCFG*
      registers in the register map; the UDC driver detects this case
      automatically (GHWCFG2 and GHWCFG4 both read as zero) and falls back to
      the values from devicetree.

  ghwcfg4:
    type: int
    required: true
    description: |
      Value of the GHWCFG4 register. It is used to determine available endpoint
      types during driver pre-initialization.
```

## dts/bindings/usb/uac1/zephyr,uac1-audio-streaming.yaml
```yaml
# Copyright (c) 2026 Ylhyra ehf.
# SPDX-License-Identifier: Apache-2.0

description: USB Audio Class 1 Audio Streaming interface

compatible: "zephyr,uac1-audio-streaming"

properties:
  linked-terminal:
    type: phandle
    required: true
    description: |
      Input or Output Terminal to which this interface is connected.

  external-interface:
    type: boolean
    description: |
      Enable if audio stream is not transmitted over USB (external interface).

  implicit-feedback:
    type: boolean
    description: |
      Enable implicit feedback on an IN audio data endpoint. For OUT endpoints
      this removes the explicit feedback endpoint requirement.

  sync-type:
    type: string
    required: true
    description: |
      Synchronization type for the isochronous audio data endpoint.

      Note: Adaptive synchronization for USB ISO IN (AudioStreaming linked to an
      Output Terminal) is unsupported and rejected by the Zephyr UAC1 driver.
    enum:
      - "asynchronous"
      - "adaptive"
      - "synchronous"

  sampling-frequencies:
    type: array
    required: true
    description: |
      Discrete sampling frequencies supported by this stream, in Hz.

  subslot-size:
    type: int
    required: true
    description: Number of bytes occupied by one audio subslot (1..4).

  bit-resolution:
    type: int
    required: true
    description: Number of effectively used bits in audio subslot.

  polling-period-us:
    type: int
    description: |
      Data endpoint polling period in microseconds.

      USB Audio Class 1 requires 1ms polling. For High-Speed devices this still
      means 1ms (bInterval = 4).

  feedback-period-us:
    type: int
    description: |
      Explicit feedback endpoint polling period in microseconds.

      USB Audio Class 1 requires 1ms polling. For High-Speed devices this still
      means 1ms (bInterval = 4).

  feedback-refresh:
    type: int
    description: |
      bRefresh value for the explicit feedback endpoint. Indicates the rate at
      which a new feedback value is available: 2^bRefresh milliseconds.
    default: 1
```

## dts/bindings/usb/uac1/zephyr,uac1-channel-cluster.yaml
```yaml
# Copyright (c) 2026 Ylhyra ehf.
# SPDX-License-Identifier: Apache-2.0

description: USB Audio Class 1 Audio Channel Cluster

properties:
  channels:
    type: int
    required: true
    description: |
      Number of logical channels in this cluster (bNrChannels).

  channel-config:
    type: int
    default: 0
    description: |
      Audio Channel Cluster spatial locations bitmap (wChannelConfig).

      Bit positions follow USB Audio Device Class 1.0 specification,
      Section 3.7.2.3 (12 predefined spatial locations).
```

## dts/bindings/usb/uac1/zephyr,uac1-feature-unit.yaml
```yaml
# Copyright (c) 2026 Ylhyra ehf.
# SPDX-License-Identifier: Apache-2.0

description: USB Audio Class 1 Feature Unit entity

compatible: "zephyr,uac1-feature-unit"

properties:
  data-source:
    type: phandle
    required: true
    description: Unit or Terminal to which this Feature Unit is connected

  controls:
    type: int
    default: 0
    description: |
      Bitmap of supported controls for the master channel. Bit positions
      follow USB Audio Device Class 1.0 specification, Appendix A.12.2:
      - BIT(0): Mute (D0)
      - BIT(1): Volume (D1)

  channel-controls:
    type: array
    description: |
      Bitmap of supported controls for each logical channel. The number of
      elements must match the channel count of the Feature Unit's data source.
      If omitted, the master channel controls are also advertised for every
      logical channel.

  volume-min:
    type: int
    description: |
      Minimum volume, in 1/256 dB units (signed 16-bit).

  volume-max:
    type: int
    description: |
      Maximum volume, in 1/256 dB units (signed 16-bit).

  volume-res:
    type: int
    description: |
      Volume resolution (step), in 1/256 dB units (signed 16-bit).
```

## dts/bindings/usb/uac1/zephyr,uac1-input-terminal.yaml
```yaml
# Copyright (c) 2026 Ylhyra ehf.
# SPDX-License-Identifier: Apache-2.0

description: USB Audio Class 1 Input Terminal entity

compatible: "zephyr,uac1-input-terminal"

include: zephyr,uac1-channel-cluster.yaml

properties:
  terminal-type:
    type: int
    required: true
    description: |
      Terminal Type constant specified in USB Audio Terminal Types.

  assoc-terminal:
    type: phandle
    description: |
      Associated terminal for bi-directional terminal types.
```

## dts/bindings/usb/uac1/zephyr,uac1-output-terminal.yaml
```yaml
# Copyright (c) 2026 Ylhyra ehf.
# SPDX-License-Identifier: Apache-2.0

description: USB Audio Class 1 Output Terminal entity

compatible: "zephyr,uac1-output-terminal"

properties:
  terminal-type:
    type: int
    required: true
    description: |
      Terminal Type constant specified in USB Audio Terminal Types.

  assoc-terminal:
    type: phandle
    description: |
      Associated terminal, e.g. for bidirectional terminal types.

  data-source:
    type: phandle
    required: true
    description: |
      Unit or Terminal this terminal receives data from.
```

## subsys/usb/device_next/class/Kconfig.uac1
```kconfig
# Copyright (c) 2026 Ylhyra ehf.
#
# SPDX-License-Identifier: Apache-2.0

config USBD_AUDIO1_CLASS
	bool "USB Audio 1 class support"
	select UDC_ENABLE_SOF
	help
	  USB Audio 1 device class support.

if USBD_AUDIO1_CLASS

module = USBD_UAC1
module-str = usbd uac1
source "subsys/logging/Kconfig.template.log_config"

endif
```

## tests/drivers/i2c/i2c_async/testcase.yaml
```yaml
common:
  tags:
    - drivers
    - i2c
  depends_on: i2c
tests:
  drivers.i2c.i2c_async:
    platform_allow:
      - sam_e54_xpro
      - pic32cx_sg41_cult
    extra_configs:
      - CONFIG_I2C_MCHP_DMA_DRIVEN=y
  drivers.i2c.i2c_async.gd32_irq:
    platform_allow:
      - gd32f450z_eval
    integration_platforms:
      - gd32f450z_eval
    harness_config:
      fixture: i2c_bus_short
  drivers.i2c.i2c_async.gd32_dma:
    platform_allow:
      - gd32f450z_eval
    integration_platforms:
      - gd32f450z_eval
    harness_config:
      fixture: i2c_bus_short
    extra_configs:
      - CONFIG_I2C_GD32_DMA=y
    extra_dtc_overlay_files:
      - boards/gd32f450z_eval.overlay
      - boards/gd32f450z_eval_dma.overlay
```

## tests/drivers/reset/gd32/testcase.yaml
```yaml
# Copyright (c) 2026, Ylhyra ehf.
# SPDX-License-Identifier: Apache-2.0

tests:
  drivers.reset.gd32:
    platform_allow:
      - native_sim/native/64
  drivers.reset.gd32.smp:
    platform_allow:
      - qemu_x86_64
    extra_configs:
      - CONFIG_SPIN_VALIDATE=y
      - CONFIG_SCHED_CPU_MASK=y
```

## tests/net/lib/mdns_responder/testcase.yaml
```yaml
common:
  tags:
    - dns
    - net
  depends_on: netif
tests:
  net.mdns:
    min_ram: 21
    timeout: 600
  net.mdns.iface_allowlist:
    min_ram: 21
    timeout: 600
    extra_configs:
      - CONFIG_MDNS_RESPONDER_IFACE_POLICY_ALLOWLIST=y
      - CONFIG_MDNS_RESPONDER_IFACE_LIST="dummy0"
  net.mdns.iface_denylist:
    min_ram: 21
    timeout: 600
    extra_configs:
      - CONFIG_MDNS_RESPONDER_IFACE_POLICY_DENYLIST=y
      - CONFIG_MDNS_RESPONDER_IFACE_LIST="dummy1"
  net.mdns.runtime_iface:
    min_ram: 21
    timeout: 600
    extra_configs:
      - CONFIG_MDNS_RESPONDER_RUNTIME_IFACE_CONTROL=y
  net.mdns.runtime_iface_allowlist:
    min_ram: 21
    timeout: 600
    extra_configs:
      - CONFIG_MDNS_RESPONDER_IFACE_POLICY_ALLOWLIST=y
      - CONFIG_MDNS_RESPONDER_IFACE_LIST="dummy0"
      - CONFIG_MDNS_RESPONDER_RUNTIME_IFACE_CONTROL=y
```

## tests/subsys/usb/uac1/testcase.yaml
```yaml
tests:
  usb.uac1.descriptors:
    tags:
      - usb
    platform_allow:
      - native_sim/native/64
      - qemu_cortex_m3
    integration_platforms:
      - native_sim/native/64
  usb.uac1.runtime:
    tags:
      - usb
    platform_allow:
      - qemu_cortex_m3
    integration_platforms:
      - qemu_cortex_m3
    extra_args:
      - EXTRA_CONF_FILE=runtime/runtime.conf
      - EXTRA_DTC_OVERLAY_FILE=runtime/runtime.overlay
  usb.uac1.runtime_pressure:
    tags:
      - usb
    platform_allow:
      - qemu_cortex_m3
    extra_args:
      - EXTRA_CONF_FILE=runtime/runtime.conf
      - EXTRA_DTC_OVERLAY_FILE=runtime/runtime.overlay
    extra_configs:
      - CONFIG_USBD_MAX_UDC_MSG=1
```
